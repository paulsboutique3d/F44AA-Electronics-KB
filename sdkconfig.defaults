## sdkconfig.defaults
```kconfig
# Camera configuration
CONFIG_SCCB_CLK_FREQ=100000
CONFIG_ESP32_CAMERA_ISR_IRAM_SAFE=y
CONFIG_ESP32_CAMERA_DMA_BUFFER_SIZE_MAX=32768
CONFIG_ESP32_CAMERA_ENABLE_PSRAM64_FIX=y
CONFIG_CAMERA_MODULE_ESP_S3_EYE=y
CONFIG_CAMERA_CORE=0
CONFIG_CAMERA_DMA_BUFFER_SIZE=8192

# ESP32-S3 specific configurations
CONFIG_ESP32S3_DEFAULT_CPU_FREQ_240=y
CONFIG_ESP32S3_DEFAULT_CPU_FREQ_MHZ=240
CONFIG_IDF_TARGET_ESP32S3=y
CONFIG_IDF_TARGET="esp32s3"

# Flash configuration
CONFIG_ESPTOOLPY_FLASHMODE_QIO=y
CONFIG_ESPTOOLPY_FLASHFREQ_80M=y
CONFIG_ESPTOOLPY_FLASHSIZE_8MB=y

# Partition table
CONFIG_PARTITION_TABLE_CUSTOM=y
CONFIG_PARTITION_TABLE_CUSTOM_FILENAME="partitions.csv"

# WiFi configuration
CONFIG_ESP32_WIFI_STATIC_RX_BUFFER_NUM=10
CONFIG_ESP32_WIFI_DYNAMIC_RX_BUFFER_NUM=32
CONFIG_ESP32_WIFI_STATIC_TX_BUFFER_NUM=0
CONFIG_ESP32_WIFI_DYNAMIC_TX_BUFFER_NUM=32

# HTTP Server
CONFIG_HTTPD_MAX_REQ_HDR_LEN=8192
CONFIG_HTTPD_MAX_URI_LEN=512

# Camera specific
CONFIG_OV2640_SUPPORT=y
CONFIG_OV3660_SUPPORT=y
CONFIG_OV5640_SUPPORT=y
CONFIG_OV7725_SUPPORT=y
CONFIG_NT99141_SUPPORT=y
CONFIG_GC2145_SUPPORT=y
CONFIG_GC032A_SUPPORT=y
CONFIG_GC0308_SUPPORT=y
CONFIG_BF3005_SUPPORT=y
CONFIG_BF20A6_SUPPORT=y

# PSRAM configuration for ESP32-S3
CONFIG_ESP32S3_SPIRAM_SUPPORT=y
CONFIG_SPIRAM_MODE_OCT=y
CONFIG_SPIRAM_SPEED_120M=y
CONFIG_SPIRAM_USE_CAPS_ALLOC=y
CONFIG_SPIRAM_USE_MALLOC=y
CONFIG_SPIRAM_MALLOC_ALWAYSINTERNAL=16384
```
